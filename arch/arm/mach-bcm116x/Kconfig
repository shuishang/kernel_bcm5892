## arch/arm/mach-bcm116x/Kconfig
```kconfig
config ARCH_SUPPORTS_BIG_ENDIAN
	bool
	default y
	depends on ARCH_BCM116X

choice
	prompt "Processor selection in BCM116x family of devices"
	depends on ARCH_BCM116X
	default ARCH_BCM2153

config ARCH_BCM2153
	bool "BCM2153"
endchoice

config BCM2153_CPUFREQ_DRV
    bool "CPUFREQ driver"
    depends on ARCH_BCM2153

menu "BCM116X Options"
	depends on ARCH_BCM116X

config BCM116X_EARLY_KGDB
    bool "Use the BCM116X polling KGDB driver"
    depends on KGDB
    depends on ARCH_BCM116X
    help
       If you say Y here, then a polling version of the KGDB serial driver will
       be used. This allows drivers that are setup prior to the serial port
       to be debugged. If you say N here then you can choose one of KGDB's
       builtin drivers.

choice
	prompt "Serial port for KGDB"
	depends on BCM116X_EARLY_KGDB
	default BCM116X_KGDB_UARTA

config BCM116X_KGDB_UARTA
	bool "UART A - Download"

config BCM116X_KGDB_UARTB
	bool "UART B - Console"

endchoice

choice
    prompt "KGDB serial port BAUD"
	depends on BCM116X_EARLY_KGDB
	default BCM116X_KGDB_115200BAUD
	help
	  gdb and the kernel stub need to agree on the baud rate to be
	  used.  Standard rates from 9600 to 115200 are allowed.

config BCM116X_KGDB_9600BAUD
	bool "9600"

config BCM116X_KGDB_19200BAUD
	bool "19200"

config BCM116X_KGDB_38400BAUD
	bool "38400"

config BCM116X_KGDB_57600BAUD
	bool "57600"

config BCM116X_KGDB_115200BAUD
	bool "115200"
endchoice

config BCM116X_DEBUG_PAUSE_KGDB
    bool "Wait for a keypress during boot - KGDB"
    select BCM_DEBUG_PAUSE
    depends on BCM116X_EARLY_KGDB
    help
      Allows the kernel to pause during the boot process. This is a convenient
      place to break into the kernel using KGDB since the appropriate KGDB
      traps have been installed.

config BCM116X_812K_SMTCLK
    bool "Enable SMT clock at 812.5 kHz"
    depends on ARCH_BCM116X
    help
      Run SMT clock at 812.5 kHz (for high accuracy profiling)


endmenu

source "drivers/char/bcm116x/Kconfig"
```

## arch/arm/mach-bcm5892/Kconfig
```kconfig
comment "BCM5892 Core"
    depends on ARCH_BCM5892

config BCM_RAM_SIZE
    hex "RAM size"

config BCM_RAM_BASE
    hex "RAM base"

config BCM_RAM_START_RESERVED_SIZE
    hex "RAM reserved"
```

## arch/arm/mach-bcmcommon/Kconfig
```kconfig
menu "BCM Options"
	depends on ARCH_BCMRING || ARCH_BCM116X

config BCM_ZRELADDR
	hex "Compressed ZREL ADDR"

config BCM_SVN_REVISION
	string "SVN Revision Number"

config BCM_EARLY_PRINTK
    bool "Enable early console printk"
    default n
    help
      Enable console printk very early in boot process.

config BCM_DEBUG_PAUSE_JTAG
    bool "Wait for a keypress during boot - JTAG"
    default n
    select BCM_DEBUG_PAUSE
    help
      Allows the kernel to pause during the boot process. This is a convenient
      place to break into the kernel using the JTAG since the MMU has been
      initialized.

config BCM_CHIP
    hex "Chip id"
    
choice
	prompt "Serial port for early printk and jtag"
	depends on BCM_EARLY_PRINTK || BCM_DEBUG_PAUSE_JTAG
	default BCM_EARLY_CONSOLE_UARTA

config BCM_EARLY_CONSOLE_UARTA
	bool "UART A - Early Console"

config BCM_EARLY_CONSOLE_UARTB
	bool "UART B - Early Console"

config BCM_EARLY_CONSOLE_UARTC
	bool "UART C - Early Console"
	depends on ARCH_BCM116X

endchoice

endmenu
```

## arch/arm/mach-bcmring/Kconfig
```kconfig
comment "BCMRING Board Type"
        depends on ARCH_BCMRING

config MACH_BCMRING_BASE
        bool "BCMRING BASE"
        depends on ARCH_BCMRING

config MACH_BCMRING_EVM
        bool "BCMRING EVM"
        depends on ARCH_BCMRING

config MACH_BCMRING_EVM_JAZZ
        bool "BCMRING EVM JAZZ"
        depends on ARCH_BCMRING

config MACH_BCMRING_EVM_RAMPAGE
        bool "BCMRING EVM RAMPAGE"
        depends on ARCH_BCMRING

config MACH_BCMRING_EVM_SEIKORA167Z
        bool "BCMRING EVM SEIKO RA167Z"
        depends on ARCH_BCMRING

config MACH_BCMRING_SP
        bool "BCMRING SP"
        depends on ARCH_BCMRING

config MACH_BCMRING_SP_WQVGA
        bool "BCMRING SP WQVGA"
        depends on ARCH_BCMRING

config MACH_BCMRING_SV
        bool "BCMRING SV"
        depends on ARCH_BCMRING

config MACH_BCMRING_SV_JAZZ
        bool "BCMRING SV JAZZ"
        depends on ARCH_BCMRING

config MACH_BCMRING_TABLET
        bool "BCMRING TABLET"
        depends on ARCH_BCMRING

config MACH_BCMRING_TABLET_SINGLE
        bool "BCMRING TABLET SINGLE VIDEOCORE"
        depends on ARCH_BCMRING

config MACH_BCMRING_TABLET_V1
        bool "BCMRING TABLET_V1"
        depends on ARCH_BCMRING

config MACH_BCMRING_TABLET_SINGLE_V1
        bool "BCMRING TABLET_V1 SINGLE VIDEOCORE"
        depends on ARCH_BCMRING

config MACH_BCMRING_VP
        bool "BCMRING VP"
        depends on ARCH_BCMRING

config MACH_BCMRING_VP_SINGLE
        bool "BCMRING VP SINGLE VIDEOCORE"
        depends on ARCH_BCMRING

config MACH_BCMRING_RB
        bool "BCMRING RB"
        depends on ARCH_BCMRING

config MACH_BCMRING_CUSTOM
        bool "BCMRING CUSTOM"
        depends on ARCH_BCMRING

config BCM_ZRELADDR
	hex "Compressed ZREL ADDR"

config BCM_SVN_REVISION
	string "SVN Revision Number"
	depends on ARCH_BCMRING

config BCM_VPM_START_ADDRESS
   hex "VPM start address"
   depends on ARCH_BCMRING

config BCMRING_SECURE_DATA_CACHE
	bool "Enable the Secure Data Cache (SDC) of BCMRING"
	default n
	depends on ARCH_BCMRING
	help
	   Enabling the Secure Data Cache (SDC) would configure the first
	   4k of the ARAM as a general storage area for secure information.
	   The SDC is currently accessible by the various boot stages or kernel.

config BCMRING_SECURE_DATA_CACHE_SIZE
	int "SDC size"

config BCMRING_SECURE_DATA_CACHE_PAGE_SIZE
    int "SDC page size"

config BCMRING_SECURE_DATA_CACHE_LOCATION
    hex "SDC location"

config BCM_RAM_SIZE
    hex "RAM size"

config BCM_RAM_BASE
    hex "RAM base"

config BCM_RAM_START_RESERVED_SIZE
    hex "RAM reserved"

config BCM_ROOT_FILE_SYSTEM
    int "BCM root file system"
```

## drivers/char/bcm116x/Kconfig
```kconfig
#
# BCM116x device configuration
#

menu "BCM116X Devices"
    depends on ARCH_BCM116X

config BCM116X_KEYPAD
    bool "Keypad"
    ---help---
        This selects whether you want to include the BCM116x keypad driver.

        If unsure, say Y.

config BCM116X_LCD
    bool "LCD Controller"
    default n if BCM_VC02
    select BCM_LCD_BACKLIGHT
    ---help---
    Enable the LCD driver? This refers to an LCD connected directly to the BCM116x.
    select LCD_API

config BCM_LCD_BTG222432
    tristate "HYUNDAI BTG222432 LCD support"
    depends on ARCH_BCM2153
    ---help---
     Support for HYUNDAI BTG222432 LCD
     Say Y here to enable HYUNDAI BTG222432 LCD driver
     Say m to make it a loadable module

config BCM116X_NET_TIMESTAMP
    bool "Add timestamp on sent packets"
    ---help---
    Add timestamps to packets

config BCM116X_SLEEP_SETTLING_TIME
    int "Sleep Mode Settling Time"
    default 60
    depends on BCM_SLEEP_MODE
    ---help---
    Sleep Mode Settling Time

config BCM116X_AUXADC
    bool "Auxiliary ADC Driver"
    ---help---
    Auxiliary ADC Driver

endmenu
```

## drivers/char/bcmring/Kconfig
```kconfig
#
# Miscellaneous Broadcom BCMRING device configuration
#

menu "Broadcom BCMRING Miscellaneous Devices"
    depends on ARCH_BCMRING

config BCM_LCD_BACKLIGHT
    bool "LCD Backlight"
    ---help---
        Select this to include the backlight driver.

        If unsure, say N.

config MM_DMA
    tristate "Multimedia DMA support"
    ---help---
        Select this to include the DMA utility for
        multimedia or graphics related DMA operations.

        If unsure, say N.

config BCMRING_GEV3
    tristate "Graphic Engine support"
    select MM_DMA
    ---help---
        Select this to include the Graphic Engine driver.
        The driver can be used to perform hardware-accelerated
        graphic operations including alpha blending, rastering,
        and color filling.

        If unsure, say N.

config BCMRING_LCD
    tristate "LCD support"
    ---help---
        Select this to include the LCD driver.

        If unsure, say N.

config BCM_LCD_BPP
    int "LCD color depth"
    ---help---
        use: 32 or 16.

config BCMRING_VPM
    bool "VPM support"
    ---help---
        Select this to include VPM support, including binary
        file loader.

        If unsure, say N.

config BCMRING_ETH_LED
    tristate "Ethernet LED support"
	default n
    depends on NET_BCMRING
    ---help---
        Select this to include LED support for BCMRING ethernet driver

        If unsure, say N.

config BCMRING_GPS
    tristate "GPS support"
	default n
    ---help---
        Select this to include GPS support for BCMRING

        If unsure, say N.
		
config BCMRING_GPS_UART
	int "GPS UART"	
	depends on BCMRING_GPS
	--help---
		GPS UART port no e.g. 0,1,2,3 to be used 
		
endmenu
```
